## config/west.yml
```yaml
manifest:
  remotes:
    - name: zmkfirmware
      url-base: https://github.com/FearlessSpiff
  projects:
    - name: zmk
      remote: zmkfirmware
      revision: main-with-native-mouse-and-cirque-trackpad
      import: app/west.yml
  self:
    path: config
```
